# file: Traffic Light.ioc
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Mcu.Family=STM32F4
Mcu.Name=STM32F401R(B-C)Tx
Mcu.Package=LQFP64
NVIC.PriorityGroup=NVIC_PRIORITYGROUP_4
NVIC.TIM2_IRQn=true\:15\:0\:false\:false\:true\:false\:true\:true
NVIC.TimeBase=TIM2_IRQn
NVIC.TimeBaseIP=TIM2
ProjectManager.HeapSize=0x200
ProjectManager.StackSize=0x400
ProjectManager.TargetToolchain=STM32CubeIDE
RCC.AHBCLKDivider=RCC_SYSCLK_DIV2
RCC.AHBFreq_Value=8000000
RCC.APB1Freq_Value=8000000
RCC.APB1TimFreq_Value=8000000
RCC.APB2Freq_Value=8000000
RCC.APB2TimFreq_Value=8000000
RCC.CortexFreq_Value=8000000
RCC.HCLKFreq_Value=8000000
RCC.HSE_VALUE=25000000
RCC.HSI_VALUE=16000000
RCC.LSE_VALUE=32768
RCC.SYSCLKFreq_VALUE=16000000
RCC.VCOOutputFreq_Value=192000000
VP_SYS_VS_tim2.Mode=TIM2
board=custom

// file: Core/Src/main.c
/* USER CODE BEGIN Header */
/**
  ******************************************************************************
  * @file           : main.c
  * @brief          : Main program body
  ******************************************************************************
  * @attention
  *
  * Copyright (c) 2024 STMicroelectronics.
  * All rights reserved.
  *
  * This software is licensed under terms that can be found in the LICENSE file
  * in the root directory of this software component.
  * If no LICENSE file comes with this software, it is provided AS-IS.
  *
  ******************************************************************************
  */
/* USER CODE END Header */
#include "main.h"

/* USER CODE BEGIN Includes */
#include <LED_interface.h>
#include <SSD_interface.h>
#include <FreeRTOS.h>
#include <task.h>
/* USER CODE END Includes */

/* USER CODE BEGIN PTD */
typedef enum {
	GREEN = 0,
	YELLOW,
	RED
} TrafficLightState_t;
/* USER CODE END PTD */

/* USER CODE BEGIN PD */
#define GREEN_LIGHT_DURATION	6000
#define YELLOW_LIGHT_DURATION	2000
#define RED_LIGHT_DURATION		6000
#define GREEN_LED_PIN			GPIO_PIN_2
#define YELLOW_LED_PIN			GPIO_PIN_1
#define RED_LED_PIN				GPIO_PIN_0
/* USER CODE END PD */

/* USER CODE BEGIN PV */
uint8_t seconds = 0;
TrafficLightState_t currentState = GREEN;
/* USER CODE END PV */

void SystemClock_Config(void);
/* USER CODE BEGIN PFP */
void vTrafficLightTask(void *pvParameters);
void vTrafficTimer(void *pvParameters);
/* USER CODE END PFP */

int main(void)
{

  /* MCU Configuration--------------------------------------------------------*/

  /* Reset of all peripherals, Initializes the Flash interface and the Systick. */
  HAL_Init();

  /* Configure the system clock */
  SystemClock_Config();

  /* Initialize all configured peripherals */
  /* USER CODE BEGIN 2 */
  LED_voidInit(GPIOA, GPIO_PIN_0);
  LED_voidInit(GPIOA, GPIO_PIN_1);
  LED_voidInit(GPIOA, GPIO_PIN_2);
  SSD_voidInit();

  xTaskCreate(vTrafficLightTask, "Traffic Light", 1024, NULL, 2, NULL);
  xTaskCreate(vTrafficTimer, "Traffic Timer", 1024, NULL, 1, NULL);

  vTaskStartScheduler();
  /* USER CODE END 2 */

  /* Infinite loop */
  while (1)
  {

  }
}

void SystemClock_Config(void)
{
  RCC_OscInitTypeDef RCC_OscInitStruct = {0};
  RCC_ClkInitTypeDef RCC_ClkInitStruct = {0};

  /** Configure the main internal regulator output voltage
  */
  __HAL_RCC_PWR_CLK_ENABLE();
  __HAL_PWR_VOLTAGESCALING_CONFIG(PWR_REGULATOR_VOLTAGE_SCALE2);

  /** Initializes the RCC Oscillators according to the specified parameters
  * in the RCC_OscInitTypeDef structure.
  */
  RCC_OscInitStruct.OscillatorType = RCC_OSCILLATORTYPE_HSI;
  RCC_OscInitStruct.HSIState = RCC_HSI_ON;
  RCC_OscInitStruct.HSICalibrationValue = RCC_HSICALIBRATION_DEFAULT;
  RCC_OscInitStruct.PLL.PLLState = RCC_PLL_NONE;
  if (HAL_RCC_OscConfig(&RCC_OscInitStruct) != HAL_OK)
  {
    Error_Handler();
  }

  /** Initializes the CPU, AHB and APB buses clocks
  */
  RCC_ClkInitStruct.ClockType = RCC_CLOCKTYPE_HCLK|RCC_CLOCKTYPE_SYSCLK
                              |RCC_CLOCKTYPE_PCLK1|RCC_CLOCKTYPE_PCLK2;
  RCC_ClkInitStruct.SYSCLKSource = RCC_SYSCLKSOURCE_HSI;
  RCC_ClkInitStruct.AHBCLKDivider = RCC_SYSCLK_DIV2;
  RCC_ClkInitStruct.APB1CLKDivider = RCC_HCLK_DIV1;
  RCC_ClkInitStruct.APB2CLKDivider = RCC_HCLK_DIV1;

  if (HAL_RCC_ClockConfig(&RCC_ClkInitStruct, FLASH_LATENCY_0) != HAL_OK)
  {
    Error_Handler();
  }
}

/* USER CODE BEGIN 4 */
void vTrafficTimer(void *pvParameters){
	uint8_t max = 6;
	while (1){

		switch (currentState) {
			case GREEN:
				max = 6;
				if (seconds <= max)
				{
					SSD_voidDisplayNumber(seconds, SSD_A);
					vTaskDelay(pdMS_TO_TICKS(1000));
					seconds++;
				}
				else{
					seconds = 0;
				}
				break;

			case YELLOW:
				max = 2;
				if (seconds <= max)
				{
					SSD_voidDisplayNumber(seconds, SSD_A);
					vTaskDelay(pdMS_TO_TICKS(1000));
					seconds++;
				}
				else{
					seconds = 0;
				}
				break;

			case RED:
				max = 6;
				if (seconds <= max)
				{
					SSD_voidDisplayNumber(seconds, SSD_A);
					vTaskDelay(pdMS_TO_TICKS(1000));
					seconds++;
				}
				else{
					seconds = 0;
				}
				break;

			default:
				seconds = 0;
				break;
		}
	}
}

void vTrafficLightTask(void *pvParameters) {
	while (1) {
		switch (currentState) {
			case GREEN:
			LED_voidOn(GPIOA, GREEN_LED_PIN, LED_FORWARD_CONNECTION);
			LED_voidOff(GPIOA, RED_LED_PIN, LED_FORWARD_CONNECTION);
			LED_voidOff(GPIOA, YELLOW_LED_PIN, LED_FORWARD_CONNECTION);
			vTaskDelay(pdMS_TO_TICKS(GREEN_LIGHT_DURATION));
			currentState = RED;
			seconds = 0;
			break;

			case YELLOW:
				LED_voidOff(GPIOA, GREEN_LED_PIN, LED_FORWARD_CONNECTION);
				LED_voidOff(GPIOA, RED_LED_PIN, LED_FORWARD_CONNECTION);
				LED_voidOn(GPIOA, YELLOW_LED_PIN, LED_FORWARD_CONNECTION);
				vTaskDelay(pdMS_TO_TICKS(YELLOW_LIGHT_DURATION));
				currentState = GREEN;
				seconds = 0;
				break;

			case RED:
				LED_voidOff(GPIOA, GREEN_LED_PIN, LED_FORWARD_CONNECTION);
				LED_voidOn(GPIOA, RED_LED_PIN, LED_FORWARD_CONNECTION);
				LED_voidOff(GPIOA, YELLOW_LED_PIN, LED_FORWARD_CONNECTION);
				vTaskDelay(pdMS_TO_TICKS(RED_LIGHT_DURATION));
				currentState = YELLOW;
				seconds = 0;
				break;

			default:
				currentState = GREEN;
				seconds = 0;
				break;
		}
	}
}
/* USER CODE END 4 */

void HAL_TIM_PeriodElapsedCallback(TIM_HandleTypeDef *htim)
{
  if (htim->Instance == TIM2) {
    HAL_IncTick();
  }
}

void Error_Handler(void)
{
  __disable_irq();
  while (1)
  {
  }
}
